## drivers/input/misc/aw8622x_haptic/Kconfig
```kconfig
config INPUT_AW862XX_HAPTIC
	tristate "Awinic AW862XX haptic driver"
	depends on I2C
	help
	  Say Y here if you have Awinic AW862XX series haptic controller
	  chip in your system.

	  If unsure, say N.

	  To compile this driver as a module, choose M here.
	  The module will be called mpr121_touchkey
```

## drivers/uwb-sr100/Kconfig
```kconfig
#
# Nxp SPI SR100 devices
#

config NXP_SR100
	tristate "Nxp SPI driver for SR100 devices"
	help
	  Say y here to enable support for NXP SR100 series devices.
	  If you are unsure of enabling that, say n here.
```
